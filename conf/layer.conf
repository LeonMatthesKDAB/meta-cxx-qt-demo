## conf/layer.conf
```bitbake
# We have a conf and classes directory, add to BBPATH
BBPATH .= ":${LAYERDIR}"

# We have recipes-* directories, add to BBFILES
BBFILES += "${LAYERDIR}/recipes-*/*/*.bb \
            ${LAYERDIR}/recipes-*/*/*.bbappend"

BBFILE_COLLECTIONS += "cxx-qt-demo"
BBFILE_PATTERN_cxx-qt-demo = "^${LAYERDIR}/"
BBFILE_PRIORITY_cxx-qt-demo = "6"

LAYERDEPENDS_cxx-qt-demo = "core rust-layer variscite-bsp qt5-layer"
LAYERSERIES_COMPAT_cxx-qt-demo = "kirkstone"
```
